## firmware/sdkconfig.defaults
```kconfig
# Ink-Player ESP32-PICO-V3-02 配置
# 放入项目根目录, idf.py build 时自动应用

##### 芯片 #####
CONFIG_IDF_TARGET="esp32"
CONFIG_ESP32_DEFAULT_CPU_FREQ_240=y
CONFIG_ESP32_DEFAULT_CPU_FREQ_MHZ=240

##### Flash (PICO-V3-02: 8MB) #####
CONFIG_ESPTOOLPY_FLASHSIZE_8MB=y
CONFIG_ESPTOOLPY_FLASHSIZE="8MB"
CONFIG_ESPTOOLPY_FLASHMODE_QIO=y
CONFIG_ESPTOOLPY_FLASHFREQ_80M=y

##### PSRAM (PICO-V3-02 自带 8MB OCTO) #####
CONFIG_SPIRAM=y
CONFIG_SPIRAM_MODE_OCT=y
CONFIG_SPIRAM_SPEED_80M=y
CONFIG_SPIRAM_USE_CAPS_ALLOC=y
CONFIG_SPIRAM_ALLOW_BSS_SEG_EXTERNAL_MEMORY=y

##### 分区表 #####
CONFIG_PARTITION_TABLE_CUSTOM=y
CONFIG_PARTITION_TABLE_CUSTOM_FILENAME="partitions.csv"
CONFIG_PARTITION_TABLE_FILENAME="partitions.csv"

##### WiFi #####
CONFIG_ESP_WIFI_ENABLED=y
CONFIG_ESP_WIFI_STATIC_RX_BUFFER_NUM=8
CONFIG_ESP_WIFI_DYNAMIC_RX_BUFFER_NUM=32
CONFIG_ESP_WIFI_IRAM_OPT=n

##### MQTT (TLS) #####
CONFIG_MQTT_TRANSPORT_SSL=y
CONFIG_MQTT_TRANSPORT_WEBSOCKET=n

##### HTTP Client #####
CONFIG_ESP_HTTP_CLIENT_ENABLE_HTTPS=y

##### SNTP  #####
CONFIG_LWIP_SNTP_UPDATE_DELAY=3600000
CONFIG_LWIP_DNS_SUPPORT_MDNS_QUERIES=y

##### I2S #####
CONFIG_I2S_ISR_IRAM_SAFE=n

##### SPI DMA — 墨水屏 DMA 传输 #####
CONFIG_SPI_MASTER_IN_IRAM=n
CONFIG_SPI_MASTER_ISR_IN_IRAM=n

##### ULP 协处理器 #####
CONFIG_ULP_COPROC_ENABLED=y

##### PCNT 编码器 #####
CONFIG_PCNT_ISR_IRAM_SAFE=n

##### ESP-SR 唤醒词 (豆包自带 VAD, 暂不需要) #####
# CONFIG_ESP_SR_ENABLED is not set

##### FreeRTOS #####
CONFIG_FREERTOS_HZ=1000

##### 日志级别 (开发阶段 Info, 发布改 Warn) #####
CONFIG_LOG_DEFAULT_LEVEL_INFO=y
CONFIG_LOG_MAXIMUM_LEVEL_DEBUG=y

##### OTA #####
CONFIG_APP_ROLLBACK_ENABLE=y

##### 编译器优化 (Debug) #####
CONFIG_COMPILER_OPTIMIZATION_DEFAULT=y
CONFIG_COMPILER_OPTIMIZATION_ASSERTIONS_ENABLE=y
CONFIG_COMPILER_STACK_CHECK_MODE_NORM=y

##### 关闭不需要的功能 #####
CONFIG_BT_ENABLED=n
CONFIG_ETH_ENABLED=n
```
